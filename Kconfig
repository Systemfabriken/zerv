## subsys/pubsub/Kconfig
```kconfig
# Copyright (c) 2023 Systemfabriken AB
# SPDX-License-Identifier: Apache-2.0

menuconfig PUBSUB
	bool "Enable PubSub" 
	default n
	select POLL
	help
		Enable the PubSub module


if PUBSUB

module = PUBSUB
module-str = PubSub

config PUBSUB_LOG_LEVEL
	int "PubSub log level" 
	default 3
	range 0 4
	help
		Set the log level for the System Controller Module. 
		0 = No Log, 1 = Error, 2 = Warning, 3 = Info, 4 = Debug 
		

endif # PUBSUB
```

## subsys/zerv/Kconfig
```kconfig
# Copyright (c) 2023 BitMan AB
# SPDX-License-Identifier: Apache-2.0

menuconfig ZERV
	bool "Enable Zerv" 
	default n
	select POLL
	help
		Enable the Zerv module


if ZERV

module = ZERV
module-str = Zerv

config ZERV_LOG_LEVEL
	int "Zerv log level" 
	default 3
	range 0 4
	help
		Set the log level for the Zerv Module. 
		0 = No Log, 1 = Error, 2 = Warning, 3 = Info, 4 = Debug 
		

endif # ZERV
```

## tests/subsys/zerv/testcase.yaml
```yaml
tests:
  inter_thread.zerv.module_interaction_no_error:
    platform_exclude:
      - hifive_unleashed
      - fvp_base_revc_2xaemv8a_smp_ns
      - native_posix
    tags: zerv
    integration_platforms:
      - native_sim
```
